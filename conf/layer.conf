## conf/layer.conf
```bitbake
# We have a conf and classes directory, add to BBPATH
BBPATH .= ":${LAYERDIR}"

# We have recipes-* directories, add to BBFILES
BBFILES += "${LAYERDIR}/recipes-*/*/*.bb \
            ${LAYERDIR}/recipes-*/*/*.bbappend"

BBFILE_COLLECTIONS += "meta-micromeritics-basesystem"
BBFILE_PATTERN_meta-micromeritics-basesystem = "^${LAYERDIR}/"
BBFILE_PRIORITY_meta-micromeritics-basesystem = "10"

LAYERDEPENDS_meta-micromeritics-basesystem = "core"
LAYERSERIES_COMPAT_meta-micromeritics-basesystem = "gatesgarth"
```
